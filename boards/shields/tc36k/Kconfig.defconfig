## boards/shields/tc36k/Kconfig.defconfig
```kconfig
# Copyright (c) 2020 The ZMK Contributors
# SPDX-License-Identifier: MIT

if SHIELD_TC36K

config ZMK_KEYBOARD_NAME
    default "TC36K"


config ZMK_HID_INDICATORS
    default y

endif
```

## boards/shields/tc36k/Kconfig.shield
```kconfig
# Copyright (c) 2025 Peter J. A. Cock
# SPDX-License-Identifier: MIT

config SHIELD_TC36K
    def_bool $(shields_list_contains,tc36k)
```

## config/west.yml
```yaml
manifest:
  defaults:
    # Current stable release is ZMK 0.3
    revision: v0.3
  remotes:
    - name: zmkfirmware
      url-base: https://github.com/zmkfirmware
    # Additional modules containing boards/shields/custom code can be listed here as well
    # See https://docs.zephyrproject.org/3.2.0/develop/west/manifest.html#projects
    - name: peterjc
      url-base: https://github.com/peterjc
    - name: urob
      url-base: https://github.com/urob
    - name: peterjc
      url-base: https://github.com/peterjc
  projects:
    - name: zmk
      remote: zmkfirmware
      import: app/west.yml
    - name: zmk-keyboard-graph-theory
      remote: peterjc
      revision: v0.3
    - name: zmk-helpers
      remote: urob
    - name: zmk-naginata
      remote: peterjc
      revision: tap-q-escape
  self:
    path: config
```
