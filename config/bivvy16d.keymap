/*                       32 (or 42 inc nav) KEY MATRIX / LAYOUT MAPPING

As in the default ZMK firmware I am treating the inner keys as higher up (LT0, LM0, RT0, and RM0),
as drawn here:

  ╭────────────────────┬────────────────────╮ ╭─────────────────────┬─────────────────────╮
  │  0   1   2   3   4 │  5   6   7   8   9 │ │ LT4 LT3 LT2 LT1 LM0 │ RM0 RT1 RT2 RT3 RT4 │
  │ 10  11  12  13  14 │ 15  16  17  18  19 │ │ LM4 LM3 LM2 LM1 LB0 │ RB0 RM1 RM2 RM3 RM4 │
  │ 20  21  22  23  24 │ 25  26  27  28  29 │ │ LB4 LB3 LB2 LB1 LH1 │ RH1 RB1 RB2 RB3 RB4 │
  │ 30  31  32  33  34 │ 35  36  37  38  39 │ │ ⬇️  ⬅️  ⏺️  ➡️  ⬆️  │ ⬆️  ⬅️  ⏺️  ➡️  ⬇️  │
  ╰───────────────╮ 40 │ 41  ╭──────────────╯ ╰───────────────╮ LH0 │ RH0 ╭───────────────╯
                  ╰────┴─────╯                                ╰─────┴─────╯

And there are the two five-way buttons too (keys 30 to 39), which is why the optional splayed
thumbs LH0 and RH0 are keys 40 and 41.

                         30 (or 40 inc nav) KEY MATRIX / LAYOUT MAPPING

Same, just without LH0 and RH0 aka keys 40 and 41. That is used here (see the chosen setting)!

*/

#pragma once

#define LT0  4  // left-top row
#define LT1  3
#define LT2  2
#define LT3  1
#define LT4  0

#define RT0  5  // right-top row
#define RT1  6
#define RT2  7
#define RT3  8
#define RT4  9

#define LM0 14 // left-middle row
#define LM1 13
#define LM2 12
#define LM3 11
#define LM4 10

#define RM0 15 // right-middle row
#define RM1 16
#define RM2 17
#define RM3 18
#define RM4 19

// Do NOT define LB0
#define LB1 23  // left-bottom row
#define LB2 22
#define LB3 21
#define LB4 20

// Do NOT define RB0
#define RB1 26  // right-bottom row
#define RB2 27
#define RB3 28
#define RB4 29

// If using all four thumbs:
// #define LH0 40  // left thumb keys
// #define LH1 24
//
// #define RH0 41  // right thumb keys
// #define RH1 25

// Using just one key per thumb
#define LH1 24  // left thumb keys
#define RH1 25  // right thumb keys

// This drops Qwerty B and N (k24 and k25), which in my Naginata where the
// inner columns are vertically inverted are the redundant left/right arrows.
// Thumbs as above.
#define LAYER_FROM36( \
    k00, k01, k02, k03, k04, k05, k06, k07, k08, k09, \
    k10, k11, k12, k13, k14, k15, k16, k17, k18, k19, \
    k20, k21, k22, k23, k24, k25, k26, k27, k28, k29, \
              k30, k31, k32, k33, k34, k35            \
) \
    k00  k01  k02  k03  k04  k05  k06  k07  k08  k09  \
    k10  k11  k12  k13  k14  k15  k16  k17  k18  k19  \
    k20  k21  k22  k23  k31  k34  k26  k27  k28  k29  \
    &kp PG_DN &kp HOME &kp KP_ENTER &kp END &kp PG_UP &kp UP &kp LEFT &kp ENTER &kp RIGHT &kp DOWN  \
//   k32  k33


#include "3x5_3.dtsi"

/ {
    chosen {
        zmk,physical-layout = &bivvy16d_L15_R15_layout;
        // Other chosen items
    };
};
