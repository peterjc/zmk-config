/*                              32 KEY MATRIX / LAYOUT MAPPING

The logical layout in the firmware is like this, where the more tucked thumb is LB0 and RB0:

  ╭────────────────────────┬────────────────────────╮ ╭─────────────────────────┬─────────────────────────╮
  │  0   1   2   3   4     │      5   6   7   8   9 │ │ LT4 LT3 LT2 LT1 LT0     │     RT0 RT1 RT2 RT3 RT4 │
  │ 10  11  12  13  14     │     15  16  17  18  19 │ │ LM4 LM3 LM2 LM1 LM0     │     RM0 RM1 RM2 RM3 RM4 │
  │ 20  21  22  23  24     │     25  26  27  28  29 │ │ LB4 LB3 LB2 LB1 LB0     │     RB0 RB1 RB2 RB3 RB4 │
  │ 30  31  32  33  34     │                        │ │ ⬆️  ⬅️  ⏺️  ➡️  ⬇️      │                         │
  ╰───────────────────╮ 35 │ 36 ╭───────────────────╯ ╰───────────────────╮ LH0 │ RH0 ╭───────────────────╯
                      ╰────┴────╯                                         ╰─────┴─────╯


However, the inner row are treated as higher up (LT0, LM0, RT0, RM0) with thumb keys LH1 and RH1:

  ╭────────────────────────┬────────────────────────╮ ╭─────────────────────────┬─────────────────────────╮
  │  0   1   2   3   4     │      5   6   7   8   9 │ │ LT4 LT3 LT2 LT1 LT0     │     RT0 RT1 RT2 RT3 RT4 │
  │ 10  11  12  13  14     │     15  16  17  18  19 │ │ LM4 LM3 LM2 LM1 LM0     │     RM0 RM1 RM2 RM3 RM4 │
  │ 20  21  22  23         │         26  27  28  29 │ │ LB4 LB3 LB2 LB1         │         RB1 RB2 RB3 RB4 │
  │ 30  31  32  33  34     │                        │ │ ⬆️  ⬅️  ⏺️  ➡️  ⬇️      │                         │
  ╰───────────────╮ 24  35 │ 36  25 ╭───────────────╯ ╰───────────────╮ LH1 LH0 │ RH0 RH1 ╭───────────────╯
                  ╰────────┴────────╯                                 ╰─────────┴─────────╯

                               30 KEY MATRIX / LAYOUT MAPPING

Same, just without LH0 and RH0 aka keys 35 and 36. That is used here (see the chosen setting)!

*/

#pragma once

#define LT0  4  // left-top row
#define LT1  3
#define LT2  2
#define LT3  1
#define LT4  0

#define RT0  5  // right-top row
#define RT1  6
#define RT2  7
#define RT3  8
#define RT4  9

#define LM0 14 // left-middle row
#define LM1 13
#define LM2 12
#define LM3 11
#define LM4 10

#define RM0 15 // right-middle row
#define RM1 16
#define RM2 17
#define RM3 18
#define RM4 19

// Do NOT define LB0
#define LB1 23  // left-bottom row
#define LB2 22
#define LB3 21
#define LB4 20

// Do NOT define RB0
#define RB1 26  // right-bottom row
#define RB2 27
#define RB3 28
#define RB4 29

// With four thumb keys in 32-key layout
// #define LH0 35  // left thumb keys
// #define LH1 24
// #define RH0 36  // right thumb keys
// #define RH1 25

// With just two thumb keys in 30-key layout
#define LH1 24  // left thumb key
#define RH1 25  // right thumb key

// This drops Qwerty B and N (k24 and k25), which in my Naginata where the
// inner columns are vertically inverted are the redundant left/right arrows.
// Thumbs as above.
#define LAYER_FROM36( \
    k00, k01, k02, k03, k04, k05, k06, k07, k08, k09, \
    k10, k11, k12, k13, k14, k15, k16, k17, k18, k19, \
    k20, k21, k22, k23, k24, k25, k26, k27, k28, k29, \
              k30, k31, k32, k33, k34, k35            \
) \
    k00  k01  k02  k03  k04  k05  k06  k07  k08  k09  \
    k10  k11  k12  k13  k14  k15  k16  k17  k18  k19  \
    k20  k21  k22  k23  k31  k34  k26  k27  k28  k29  \
    &kp UP &kp LEFT &kp ENTER &kp RIGHT &kp DOWN  \
//                        k32  k33

#include "3x5_3.dtsi"

/ {
    chosen {
        zmk,physical-layout = &physical_layout30;
        // Other chosen items
    };
};
