// Other than the Hesse being limited to 4-key roll-over it is
// essentially the same as the TC36K (which has 6-key roll-over).
#define CONFIG_WIRELESS
#include <dt-bindings/zmk/bt.h>

#include "tc36k.keymap"
