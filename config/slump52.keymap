/*                              35 core KEY MATRIX / LAYOUT MAPPING

  ╭─────────────────────╮      ╭───────────────────────╮ ╭─────────────────────────╮      ╭────────────────────────╮
  │0  1   2   3   4   5 │      │  6   7   8   9  10 ...│ │ LN5 LN4 LT3 LT2 LT1 LT0 │      │ RT0 RT1 RT2 RT3 RN4 ...│
  │  15  16  17  18  19 │      │ 20  21  22  23  24 ...│ │     LT4 LM3 LM2 LM1 LM0 │      │ RM0 RM1 RM2 RM3 RT4 ...│
  │  28  29  30  31  32 ╰──────╯ 33  34  35  36  37 ...│ │     LM4 LB3 LB2 LB1 LH2 ╰──────╯ RH2 RB1 RB2 RB3 RM4 ...│
  │  41  ╭───────────╮ 42  43  44 ╭───────────╮  49 ...│ │     LB4 ╭────────────╮ LH1 RH0 RH1 ╭───────────╮ RB4 ...│
  ╰──────╯           ╰────────────╯           ╰────────╯ ╰─────────╯            ╰─────────────╯           ╰────────╯

Using pinky stagger here, and treating the thumbs as five thumb keys with no Qwerty B and N (LB0 and RB0).

*/

#pragma once

// Not defining the extra key top left
#define LT0  5  // left-top row
#define LT1  4
#define LT2  3
#define LT3  2
#define LT4  15

// Not defining the extra keys top right
#define RT0  6  // right-top row
#define RT1  7
#define RT2  8
#define RT3  9
#define RT4  24

#define LM0 19  // left-middle row
#define LM1 18
#define LM2 17
#define LM3 16
#define LM4 28

#define RM0 20  // right-middle row
#define RM1 21
#define RM2 22
#define RM3 23
#define RM4 37

// Do NOT define LB0
#define LB1 31  // left-bottom row
#define LB2 30
#define LB3 29
#define LB4 41

// Do NOT define RB0
#define RB1 34  // right-bottom row
#define RB2 35
#define RB3 36
#define RB4 49

#define LH0 43  // left thumb keys inc shared central one
#define LH1 42
#define LH2 32

#define RH0 43  // right thumb keys inc shared central one
#define RH1 44
#define RH2 33

// This drops Qwerty B and N (k24 and k25), which in my Naginata where the
// inner columns are vertically inverted are the redundant left/right arrows.
#define LAYER_FROM36( \
    k00, k01, k02, k03, k04, k05, k06, k07, k08, k09, \
    k10, k11, k12, k13, k14, k15, k16, k17, k18, k19, \
    k20, k21, k22, k23, k24, k25, k26, k27, k28, k29, \
              k30, k31, k32, k33, k34, k35            \
) \
    k00  k00  k01  k02  k03  k04     k05  k06  k07  k08  k09 k09 &kp N7 &kp N8 &kp N9\
         k00  k11  k12  k13  k14     k15  k16  k17  k18  k09     &kp N4 &kp N5 &kp N6 \
         k10  k21  k22  k23  k31     k34  k26  k27  k28  k19     &kp N1 &kp N2 &kp N3 \
         k20                 k31 k32 k34 &kp LEFT &kp DOWN &kp UP &kp RIGHT k29 &kp N0 &kp RET

#include "3x5_3.dtsi"
